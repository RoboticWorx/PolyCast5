#include "lcd_boot_splash.h"

#include "polycast5_macros.h" // POLYCAST5_EN_BOOT_SCREEN, POLYCAST5_PRIORITY_HIGH, POLYCAST5_USE_PSRAM_BSS

#ifdef POLYCAST5_EN_BOOT_SCREEN

#include <stdbool.h>
#include <stdint.h>

#include "freertos/FreeRTOS.h"
#include "freertos/semphr.h"
#include "freertos/task.h"

#include "esp_attr.h" // EXT_RAM_BSS_ATTR (POLYCAST5_USE_PSRAM_BSS)
#include "esp_log.h"

#include "gpio_task.h" // xSPIBusMutex
#include "lcd_utils.h" // HOR_RES, VER_RES
#include "lcd_boot_splash_art.h" // s_art_* masks, generated by scripts/dev/boot_splash_art.py

static const char *TAG = "LCD_SPLASH";

/* ===========================================================================
 * Layout and colours
 * ========================================================================= */

// Same truncation as LVGL's lv_color_to_u16(), so SPLASH_BG is the exact RGB565 LVGL draws for that colour
#define SPLASH_RGB565(r, g, b) ((uint16_t)((((r) >> 3) << 11) | (((g) >> 2) << 5) | ((b) >> 3)))
// Default user_primary_color in lcd_task.c, the screen background behind every page. The homescreen animation covers it
#define SPLASH_BG             SPLASH_RGB565(0x00, 0x00, 0x8B)
#define SPLASH_WORDMARK_COLOR SPLASH_RGB565(0xFF, 0xFF, 0xFF)
#define SPLASH_TEXT_COLOR     SPLASH_RGB565(0xFF, 0xFF, 0xFF)
#define SPLASH_ICON_ON        SPLASH_RGB565(0xFF, 0xFF, 0xFF) // Icon under the sweep highlight
#define SPLASH_ICON_OFF       SPLASH_RGB565(0x5C, 0x5C, 0xB6) // White at ~36% over SPLASH_BG

// Everything centred horizontally; these are the top edges in screen px
#define SPLASH_WORDMARK_Y 13
#define SPLASH_TEXT_Y     69
#define SPLASH_ICON_Y     101
#define SPLASH_ICON_PITCH 40 // Centre to centre

#define SPLASH_FRAME_MS   50 // 20 fps
#define SPLASH_DOT_FRAMES 8  // One more dot every 400 ms

// A highlight sweeps left to right across the radio icons. 0 leaves them all solid
#define SPLASH_ICON_SWEEP    1
#define SPLASH_SWEEP_STEP_Q8 43 // Icons per frame, Q8: one icon every ~300 ms

#define SPLASH_PUSH_MAX_PX 512 // spi_master_write_colors() staging limit
#define SPLASH_TASK_STACK  (1024 * 2)

// Screen-space rectangle in px, origin top-left of the visible 240 x 135 window
typedef struct {
    int x, y, w, h;
} rect_t;

static TFT_t *s_dev;                          // Panel handle from lcd_init_driver(), used by the task
static uint8_t s_dots = ART_TEXT_DOTS;        // Dots shown after "Booting up", 0..ART_TEXT_DOTS
static uint16_t s_icon_color[ART_ICON_COUNT]; // Tint each icon was last drawn with
static volatile bool s_stop = false;          // Set by lcd_boot_splash_stop(), read by splash_task

// One transfer's worth; draw_rect() slices anything bigger
POLYCAST5_USE_PSRAM_BSS static uint16_t s_fb[SPLASH_PUSH_MAX_PX];

// 4bpp mask coverage (0..15) to blend weight (0..32)
static const uint8_t s_a4_to_a5[16] = {0, 2, 4, 6, 9, 11, 13, 15, 17, 19, 21, 23, 26, 28, 30, 32};

/* ===========================================================================
 * Drawing
 * ========================================================================= */

// Left edge of icon i: the row is centred on the screen with the middle icon on the centre line
static inline int icon_x(int i)
{
    return HOR_RES / 2 + (i - ART_ICON_COUNT / 2) * SPLASH_ICON_PITCH - ART_ICON_PX / 2;
}

// a5: 0..32. Spreads the fields to 0x07E0F81F so one multiply blends all three
static inline uint16_t blend565(uint16_t bg, uint16_t fg, uint32_t a5)
{
    if (a5 == 0) {
        return bg;
    }
    if (a5 >= 32) {
        return fg;
    }
    uint32_t b = (bg | ((uint32_t)bg << 16)) & 0x07E0F81F;
    uint32_t f = (fg | ((uint32_t)fg << 16)) & 0x07E0F81F;
    uint32_t m = ((f * a5 + b * (32 - a5)) >> 5) & 0x07E0F81F;
    return (uint16_t)(m | (m >> 16));
}

// Intersection of a and b into out; false when they do not overlap
static bool rect_clip(rect_t a, rect_t b, rect_t *out)
{
    int x0 = a.x > b.x ? a.x : b.x;
    int y0 = a.y > b.y ? a.y : b.y;
    int x1 = (a.x + a.w < b.x + b.w) ? a.x + a.w : b.x + b.w;
    int y1 = (a.y + a.h < b.y + b.h) ? a.y + a.h : b.y + b.h;
    if (x1 <= x0 || y1 <= y0) {
        return false;
    }
    *out = (rect_t){ x0, y0, x1 - x0, y1 - y0 };
    return true;
}

// Tint a 4bpp mask placed at (mx, my) into out, which holds the pixels of dst row-major
// Only the part of the mask inside dst is touched. mw can be narrower than the art to clip it
static void blit_mask(const uint8_t *mask, int stride, int mx, int my, int mw, int mh, uint16_t color,
                      rect_t dst, uint16_t *out)
{
    rect_t m;
    if (!rect_clip((rect_t){ mx, my, mw, mh }, dst, &m)) {
        return;
    }
    for (int y = m.y; y < m.y + m.h; y++) {
        const uint8_t *row = mask + (y - my) * stride;
        uint16_t *px = out + (y - dst.y) * dst.w + (m.x - dst.x);
        for (int x = m.x; x < m.x + m.w; x++, px++) {
            // Two pixels per byte, high nibble on the left (see the generator's emit())
            int col = x - mx;
            uint8_t a4 = (row[col >> 1] >> ((col & 1) ? 0 : 4)) & 0x0F;
            *px = blend565(*px, color, s_a4_to_a5[a4]);
        }
    }
}

// Composite every layer over dst (at most SPLASH_PUSH_MAX_PX pixels) into s_fb
// Always the whole scene, so any rect redraws correctly whatever it overlaps
static void render_rect(rect_t dst)
{
    for (int i = 0; i < dst.w * dst.h; i++) {
        s_fb[i] = SPLASH_BG;
    }

    blit_mask(s_art_wordmark, ART_WORDMARK_STRIDE, (HOR_RES - ART_WORDMARK_W) / 2, SPLASH_WORDMARK_Y,
              ART_WORDMARK_W, ART_WORDMARK_H, SPLASH_WORDMARK_COLOR, dst, s_fb);
    // Clipped at s_art_text_cut[s_dots] to show only that many dots
    blit_mask(s_art_text, ART_TEXT_STRIDE, (HOR_RES - ART_TEXT_W) / 2, SPLASH_TEXT_Y,
              s_art_text_cut[s_dots], ART_TEXT_H, SPLASH_TEXT_COLOR, dst, s_fb);
    for (int i = 0; i < ART_ICON_COUNT; i++) {
        blit_mask(s_art_icons[i], ART_ICON_STRIDE, icon_x(i), SPLASH_ICON_Y,
                  ART_ICON_PX, ART_ICON_PX, s_icon_color[i], dst, s_fb);
    }
}

// A fresh window per transfer, as st7789_flush_cb does: one RAMWR across several bursts is unproven here
// Caller holds xSPIBusMutex, or owns the panel outright during init
static void push_rect(rect_t r)
{
    spi_master_write_command(s_dev, 0x2A); // CASET
    spi_master_write_addr(s_dev, r.x + s_dev->_offsetx, r.x + r.w - 1 + s_dev->_offsetx);
    spi_master_write_command(s_dev, 0x2B); // RASET
    spi_master_write_addr(s_dev, r.y + s_dev->_offsety, r.y + r.h - 1 + s_dev->_offsety);
    spi_master_write_command(s_dev, 0x2C); // RAMWR
    spi_master_write_colors(s_dev, s_fb, (uint16_t)(r.w * r.h));
}

// Render and send r in row slices of at most SPLASH_PUSH_MAX_PX pixels
static void draw_rect(rect_t r)
{
    int rows = SPLASH_PUSH_MAX_PX / r.w;
    for (int y = r.y; y < r.y + r.h; y += rows) {
        rect_t slice = { r.x, y, r.w, (r.y + r.h - y < rows) ? r.y + r.h - y : rows };
        render_rect(slice);
        push_rect(slice);
    }
}

/* ===========================================================================
 * Animation task
 * ========================================================================= */

// Tint of every icon for highlight position pos_q8 (icon index, Q8)
static void icon_colors(int32_t pos_q8, uint16_t *out)
{
    for (int i = 0; i < ART_ICON_COUNT; i++) {
#if SPLASH_ICON_SWEEP
        int32_t d = pos_q8 - (i << 8);
        int32_t k = 256 - (d < 0 ? -d : d); // Triangle, one icon either side
        if (k < 0) {
            k = 0;
        }
        k = (k * k * (768 - 2 * k)) >> 16; // Smoothstep, so the highlight eases in and out
        out[i] = blend565(SPLASH_ICON_OFF, SPLASH_ICON_ON, (uint32_t)(k + 4) >> 3);
#else
        (void)pos_q8;
        out[i] = SPLASH_ICON_ON;
#endif
    }
}

// Started by lcd_boot_splash_show(), runs until lcd_boot_splash_stop() and then deletes itself
// Priority HIGH like lcd_task, which never blocks during its setup, so a lower one would freeze
static void splash_task(void *arg)
{
    (void)arg;
    uint32_t frame = 0;
    int32_t pos_q8 = -256; // Highlight enters from the left of the first icon...
    TickType_t wake = xTaskGetTickCount();

    while (!s_stop) {
        xTaskDelayUntil(&wake, pdMS_TO_TICKS(SPLASH_FRAME_MS));
        frame++;

        // Dots run 3, 0, 1, 2, 3...: the static paint already showed all three
        uint8_t dots = (uint8_t)((ART_TEXT_DOTS + frame / SPLASH_DOT_FRAMES) % (ART_TEXT_DOTS + 1));
        bool dots_changed = dots != s_dots;
        s_dots = dots;

        pos_q8 += SPLASH_SWEEP_STEP_Q8;
        if (pos_q8 >= (ART_ICON_COUNT << 8)) {
            pos_q8 = -256; // ...and leaves past the last, so the wrap is invisible
        }
        uint16_t colors[ART_ICON_COUNT];
        icon_colors(pos_q8, colors);

        xSemaphoreTake(xSPIBusMutex, portMAX_DELAY); // Lock SPI bus
        // Checked under the mutex: once LVGL has drawn, no splash frame may follow it
        if (!s_stop) {
            // Only what changed: usually one or two icons, one transfer each
            for (int i = 0; i < ART_ICON_COUNT; i++) {
                if (colors[i] != s_icon_color[i]) {
                    s_icon_color[i] = colors[i];
                    draw_rect((rect_t){ icon_x(i), SPLASH_ICON_Y, ART_ICON_PX, ART_ICON_PX });
                }
            }
            // The dots box spans from the end of "Booting up" to the last dot
            if (dots_changed) {
                int x = (HOR_RES - ART_TEXT_W) / 2 + s_art_text_cut[0];
                draw_rect((rect_t){ x, SPLASH_TEXT_Y, s_art_text_cut[ART_TEXT_DOTS] - s_art_text_cut[0], ART_TEXT_H });
            }
        }
        xSemaphoreGive(xSPIBusMutex); // Release SPI bus
    }

    vTaskDelete(NULL); // Stack is freed by the idle task; s_fb stays (static)
}

/* ===========================================================================
 * Public API
 * ========================================================================= */

// Called once from lcd_init_driver() on the main task, before the backlight comes on
void lcd_boot_splash_show(TFT_t *dev)
{
    s_dev = dev;
    icon_colors(-256, s_icon_color); // Sweep not started yet: every icon dim

    // Paint the whole window: GRAM powers up holding noise
    draw_rect((rect_t){ 0, 0, HOR_RES, VER_RES });

    // No task just means a still splash; LVGL's first frame still replaces it
    if (xTaskCreate(splash_task, "boot_splash", SPLASH_TASK_STACK, NULL, POLYCAST5_PRIORITY_HIGH, NULL) != pdPASS) {
        ESP_LOGE(TAG, "Failed to start the boot splash task, it stays still");
    }
}

// Called from st7789_flush_cb() on every LVGL flush and from lcd_panel_sleep(); only sets a flag
void lcd_boot_splash_stop(void)
{
    s_stop = true;
}

#endif // POLYCAST5_EN_BOOT_SCREEN
